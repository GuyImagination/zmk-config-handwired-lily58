## config/west.yml
```yaml
manifest:
  defaults:
    revision: main   # Use latest ZMK
  remotes:
    - name: zmkfirmware
      url-base: https://github.com/zmkfirmware
  projects:
    - name: zmk
      remote: zmkfirmware
      import: app/west.yml
  self:
    path: config
```
